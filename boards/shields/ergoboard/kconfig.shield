## boards/shields/ergoboard/kconfig.shield
```kconfig
config SHIELD_ergoboard_LEFT
	def_bool $(shields_list_contains,ergoboard_left)

config SHIELD_ergoboard_RIGHT
	def_bool $(shields_list_contains,ergoboard_right)
```

## config/boards/shields/ergoboard/kconfig.shield
```kconfig
config SHIELD_ERGOBOARD_LEFT
	def_bool $(shields_list_contains,ergoboard_left)

config SHIELD_ERGOBOARD_RIGHT
	def_bool $(shields_list_contains,ergoboard_right)
```
