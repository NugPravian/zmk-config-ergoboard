#include <dt-bindings/led/led.h>

 / {
        chosen {
            zephyr,led-strip = &rgb_led;
        };

        rgb_led: ws2812 {
            compatible = "worldsemi,ws2812-gpio";
            chain-length = <16>;
            color-mapping = <LED_COLOR_ID_GREEN
                             LED_COLOR_ID_RED
                             LED_COLOR_ID_BLUE>;
            reset-delay = <50>;
            gpios = <&gpio0 08>;
            delay-t1h = <58>;
            delay-t1l = <32>;
            delay-t0h = <16>;
            delay-t0l = <32>;
        };
  };
